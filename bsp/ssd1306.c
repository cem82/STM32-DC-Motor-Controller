#include <string.h>
#include "ssd1306.h"
#include "main.h"

extern I2C_HandleTypeDef hi2c1;

#define SSD1306_ADDR        (0x3C << 1)
#define SSD1306_CTRL_CMD    0x00    // following bytes are commands
#define SSD1306_CTRL_DATA   0x40    // bit 6 = 1 -> following bytes are pixel data
#define SSD1306_BUF_SIZE    (SSD1306_WIDTH * SSD1306_HEIGHT / 8)   // 1024 bytes

static uint8_t s_buf[SSD1306_BUF_SIZE];   // framebuffer in RAM

static bool write_cmds(const uint8_t *cmds, uint16_t len)
{
    return HAL_I2C_Mem_Write(&hi2c1, SSD1306_ADDR, SSD1306_CTRL_CMD,
                             I2C_MEMADD_SIZE_8BIT, (uint8_t *)cmds, len, 100) == HAL_OK;
}

bool ssd1306_init(void)
{
    static const uint8_t init_seq[] = {
        0xAE,        // display off
        0x20, 0x00,  // horizontal addressing mode
        0x40,        // start line 0
        0xA1,        // segment remap (mirror X)
        0xC8,        // COM scan direction (mirror Y)
        0xA8, 0x3F,  // multiplex ratio: 64 rows
        0xD3, 0x00,  // display offset 0
        0xD5, 0x80,  // clock divide
        0xDA, 0x12,  // COM pins config for 128x64
        0x81, 0x7F,  // contrast
        0xD9, 0xF1,  // pre-charge period
        0xDB, 0x40,  // VCOMH level
        0xA4,        // display follows RAM content
        0xA6,        // normal (not inverted)
        0x8D, 0x14,  // enable internal charge pump
        0xAF,        // display on
    };
    return write_cmds(init_seq, sizeof(init_seq));
}

void ssd1306_fill(bool on)
{
    memset(s_buf, on ? 0xFF : 0x00, sizeof(s_buf));   // 0xFF = all 8 pixels ON
}

bool ssd1306_update(void)
{
    static const uint8_t window[] = {
        0x21, 0, SSD1306_WIDTH - 1,          // column range 0..127
        0x22, 0, (SSD1306_HEIGHT / 8) - 1,   // page range 0..7
    };
    if (!write_cmds(window, sizeof(window)))
    {
        return false;
    }
    return HAL_I2C_Mem_Write(&hi2c1, SSD1306_ADDR, SSD1306_CTRL_DATA,
                             I2C_MEMADD_SIZE_8BIT, s_buf, sizeof(s_buf), 200) == HAL_OK;
}

/* ------------------------------------------------------------------------- */
/* Text                                                                      */
/* ------------------------------------------------------------------------- */

/* 5x7 font, ASCII 32..126. Each character = 5 columns, bit 0 = top pixel. */
static const uint8_t k_font5x7[95][5] = {
    {0x00,0x00,0x00,0x00,0x00}, // ' '
    {0x00,0x00,0x5F,0x00,0x00}, // '!'
    {0x00,0x07,0x00,0x07,0x00}, // '"'
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    {0x10,0x08,0x08,0x10,0x08}, // '~'
};

#define FONT_FIRST_CHAR  32    // ASCII code of the first row (' ')
#define FONT_LAST_CHAR   126   // ASCII code of the last row ('~')
#define CHAR_WIDTH       6     // 5 font columns + 1 empty column between letters

static uint8_t s_cur_x    = 0;   // cursor: pixel column 0..127
static uint8_t s_cur_line = 0;   // cursor: text line (page) 0..7

void ssd1306_set_cursor(uint8_t x, uint8_t line)
{
    s_cur_x    = x;
    s_cur_line = line;
}

void ssd1306_clear_line(uint8_t line)
{
    memset(&s_buf[line * SSD1306_WIDTH], 0x00, SSD1306_WIDTH);   // 128 bytes = one text line
}

static void write_char(char ch)
{
    if (ch < FONT_FIRST_CHAR || ch > FONT_LAST_CHAR)
    {
        ch = '?';                                   // unknown character -> '?'
    }
    if (s_cur_x + CHAR_WIDTH > SSD1306_WIDTH)
    {
        return;                                     // no room left on this line
    }

    const uint8_t *glyph = k_font5x7[ch - FONT_FIRST_CHAR];     // row in the font table
    uint16_t idx = s_cur_line * SSD1306_WIDTH + s_cur_x;        // byte in the framebuffer

    for (uint8_t i = 0; i < 5; i++)
    {
        s_buf[idx + i] = glyph[i];                  // copy the 5 columns
    }
    s_buf[idx + 5] = 0x00;                          // empty column after the letter

    s_cur_x += CHAR_WIDTH;                          // move cursor to the next position
}

void ssd1306_write_string(const char *s)
{
    while (*s != '\0')        // a C string ends with the '\0' character
    {
        write_char(*s);
        s++;                  // next character
    }
}
